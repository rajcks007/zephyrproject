## New_Projects/new_learing_blink_led/build/Kconfig/boards/Kconfig.nucleo_f401re
```kconfig
# Load board Kconfig descriptions.
osource "C:/zephyrproject/zephyr/boards/st/nucleo_f401re/Kconfig.nucleo_f401re"
```
